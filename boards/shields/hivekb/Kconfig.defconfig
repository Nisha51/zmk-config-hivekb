## boards/shields/hivekb/Kconfig.defconfig
```kconfig
if SHIELD_HIVEKB_LEFT

config ZMK_KEYBOARD_NAME
    default "HiveKB"

config ZMK_SPLIT_ROLE_CENTRAL
    default y

endif

if SHIELD_HIVEKB_LEFT || SHIELD_HIVEKB_RIGHT

config ZMK_SPLIT
    default y

endif
```

## boards/shields/hivekb/Kconfig.shield
```kconfig
config SHIELD_HIVEKB_LEFT
    def_bool $(shields_list_contains,hivekb_left)

config SHIELD_HIVEKB_RIGHT
    def_bool $(shields_list_contains,hivekb_right)
```
